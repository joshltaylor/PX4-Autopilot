## src/modules/articulated_landing_gear/Kconfig
```kconfig
menuconfig MODULES_ARTICULATED_LANDING_GEAR
	bool "articulated_landing_gear"
	default n
	---help---
		Enable support for articulated_landing_gear

menuconfig USER_ARTICULATED_LANDING_GEAR
	bool "articulated_landing_gear running as userspace module"
	default n
	depends on BOARD_PROTECTED && MODULES_ARTICULATED_LANDING_GEAR
	---help---
		Put articulated_landing_gear in userspace memory
```

## src/modules/dynamixel_serial/Kconfig
```kconfig
menuconfig MODULES_DYNAMIXEL_SERIAL
	bool "dynamixel_serial"
	default n
	---help---
		Enable support for dynamixel_serial

menuconfig USER_DYNAMIXEL_SERIAL
	bool "dynamixel_serial running as userspace module"
	default n
	depends on BOARD_PROTECTED && MODULES_DYNAMIXEL_SERIAL
	---help---
		Put dynamixel_serial in userspace memory
```

## src/modules/tilt_rotors/Kconfig
```kconfig
menuconfig MODULES_TILT_ROTORS
	bool "tilt_rotors"
	default n
	---help---
		Enable support for tilt_rotors

menuconfig USER_TILT_ROTORS
	bool "tilt_rotors running as userspace module"
	default n
	depends on BOARD_PROTECTED && MODULES_TILT_ROTORS
	---help---
		Put tilt_rotors in userspace memory
```
